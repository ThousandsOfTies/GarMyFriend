/dts-v1/;
/plugin/;

/ {
    compatible = "allwinner,sun50i-h616";
    fragment@0 {
        target-path = "/aliases";
        __overlay__ { spi1 = "/soc/spi@5011000"; };
    };
    fragment@1 {
        target = <&spi1>;
        __overlay__ {
            status = "okay";
            pinctrl-names = "default";
            pinctrl-0 = <&spi1_pins &spi1_cs0_pin>;
            #address-cells = <1>;
            #size-cells = <0>;
            spidev@0 {
                // Same spidev binding used by Armbian's packaged overlays.
                compatible = "rohm,dh2228fv";
                reg = <0>;
                spi-max-frequency = <24000000>;
                status = "okay";
            };
        };
    };
};
